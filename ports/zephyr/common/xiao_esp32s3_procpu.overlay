/*
 * RadioMesh Zephyr examples — shared devicetree overlay.
 * Board: Seeed XIAO ESP32-S3 + Wio-SX1262 kit.
 *
 * This is the SINGLE SOURCE OF TRUTH for the SX1262 wiring, referenced by every
 * example (tx/rx/…) via DTC_OVERLAY_FILE in their CMakeLists. Duplicating pins
 * per-example invites silent drift, so they live here once.
 *
 * Pin mapping is the authoritative Wio-SX1262 wiring, cross-confirmed by three
 * independent sources that all agree these are raw ESP32-S3 GPIO numbers:
 *   - RadioMesh's own Arduino preset XIAO_ESP32S3_WIO_SX1262 = PinConfig(41,42,40,39)
 *   - Meshtastic variants/esp32s3/seeed_xiao_s3/variant.h
 *   - the XIAO ESP32-S3 Arduino variant uses identity pin numbering (no remap)
 *
 *   Signal   GPIO   Zephyr DT              (GPIO N>=32 lives on gpio1, pin N-32)
 *   NSS/CS   41     <&gpio1 9>
 *   RST      42     <&gpio1 10>
 *   BUSY     40     <&gpio1 8>
 *   DIO1     39     <&gpio1 7>
 *   SCK/MOSI/MISO  7/9/8   board pinctrl (spim2_default)
 *   DIO2 -> SX1262 internal RF switch (dio2-tx-enable / SX126X_DIO2_AS_RF_SWITCH)
 *   DIO3 -> SX1262 TCXO power 1.8 V (dio3-tcxo-voltage)
 *   RXEN = GPIO38 (external antenna RX-enable; handled for OTA, not needed for init)
 *
 * NOTE: gpio1-bank pins (GPIO>=32) require Zephyr's gpio_esp32 fix that uses
 * BIT64() in gpio_pin_is_valid() (fixed on main; our pinned 4.4.0 needs the
 * patch in ../patches/0001-gpio_esp32-BIT64-valid-mask.patch).
 */
#include <zephyr/dt-bindings/lora/sx126x.h>

/ {
	aliases {
		lora0 = &lora;
	};
};

&spi2 {
	status = "okay";
	cs-gpios = <&gpio1 9 GPIO_ACTIVE_LOW>; /* NSS/CS = GPIO41 */

	lora: lora@0 {
		compatible = "semtech,sx1262";
		reg = <0>;
		spi-max-frequency = <8000000>;
		reset-gpios = <&gpio1 10 GPIO_ACTIVE_LOW>; /* RST  = GPIO42 */
		busy-gpios = <&gpio1 8 GPIO_ACTIVE_HIGH>;  /* BUSY = GPIO40 */
		dio1-gpios = <&gpio1 7 GPIO_ACTIVE_HIGH>;  /* DIO1 = GPIO39 */
		dio2-tx-enable;                            /* SX1262 DIO2 -> internal RF switch */
		dio3-tcxo-voltage = <SX126X_DIO3_TCXO_1V8>; /* SX1262 DIO3 -> TCXO 1.8 V */
		tcxo-power-startup-delay-ms = <10>;
		status = "okay";
	};
};
