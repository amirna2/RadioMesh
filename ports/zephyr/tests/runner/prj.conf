## CMakeLists.txt
```
cmake_minimum_required(VERSION 3.20.0)

# On-board test runner: builds ONE suite from the repo's test/ directory
# (selected with -DSUITE=<directory name>) against the full RadioMesh library,
# with Unity and a small adapter that runs the suite and reports the result.
# Run it through `make test SUITE=<name>` (ports/zephyr/Makefile).

# Same kit overlay as the examples (single source of truth in ../../common).
# Must be set before find_package(Zephyr).
set(DTC_OVERLAY_FILE "${CMAKE_CURRENT_LIST_DIR}/../../common/xiao_esp32s3_procpu.overlay")

find_package(Zephyr REQUIRED HINTS $ENV{ZEPHYR_BASE})
project(radiomesh_test_runner C CXX)

set(RM_REPO ${CMAKE_CURRENT_LIST_DIR}/../../../..)
set(RM_SUITE_DIR ${RM_REPO}/test/${SUITE})
if(NOT SUITE OR NOT IS_DIRECTORY ${RM_SUITE_DIR})
  message(FATAL_ERROR "RadioMesh tests: set -DSUITE=<directory in test/>, e.g. -DSUITE=test_Packet (got '${SUITE}')")
endif()

# Unity: west project `unity`, pinned in west.yml to the version PlatformIO
# uses. Our manifest places every project next to this repo in the west topdir.
set(RM_UNITY_DIR ${RM_REPO}/../modules/test/unity/src)
if(NOT EXISTS ${RM_UNITY_DIR}/unity.c)
  message(FATAL_ERROR "RadioMesh tests: Unity not found at ${RM_UNITY_DIR}; run `west update unity`")
endif()

# Same flags as the PlatformIO test environments (pio-config/common-test.ini),
# build-wide so the library logs at the same level as on Arduino.
zephyr_compile_definitions(UNIT_TEST RM_LOG_VERBOSE)

file(GLOB RM_SUITE_SOURCES ${RM_SUITE_DIR}/*.cpp)
# Native-style suites define main(); rename it so the adapter's main() runs it.
set_source_files_properties(${RM_SUITE_SOURCES} PROPERTIES COMPILE_DEFINITIONS main=rm_test_main)

target_compile_definitions(app PRIVATE UNITY_INCLUDE_CONFIG_H)
target_include_directories(app PRIVATE inc ${RM_UNITY_DIR})
target_sources(app PRIVATE src/TestRunner.cpp ${RM_UNITY_DIR}/unity.c ${RM_SUITE_SOURCES})
```

## prj.conf
```kconfig
# On-board test runner. Same kernel and library configuration as
# examples/standard, except console output (see Logging below).

# --- LoRa PHY stack (native in-tree SX126x driver) ---
CONFIG_LORA=y
CONFIG_LORA_MODULE_BACKEND_NATIVE=y
# The devicetree auto-enables the unused legacy SX126x driver symbol; keep it off.
CONFIG_LORA_SX126X=n
CONFIG_SPI=y
CONFIG_GPIO=y

# --- C++17 with full STL (the RadioMesh core uses std::vector/std::array/std::string) ---
CONFIG_CPP=y
CONFIG_STD_CPP17=y
CONFIG_REQUIRES_FULL_LIBC=y
CONFIG_GLIBCXX_LIBCPP=y
CONFIG_CPP_EXCEPTIONS=y

# --- Heap for std::vector/std::string allocations ---
CONFIG_COMMON_LIBC_MALLOC_ARENA_SIZE=16384

# --- Storage: NVS on the devicetree storage_partition (ZephyrNVSStorage) ---
CONFIG_FLASH=y
CONFIG_FLASH_MAP=y
CONFIG_NVS=y

# --- Platform services (ZephyrPlatform): chip id and entropy ---
CONFIG_HWINFO=y
CONFIG_ENTROPY_GENERATOR=y

# --- Logging ---
# The RadioMesh Logger and Unity both write through printk. With the log
# subsystem off, printk goes straight to the console: test results and library
# logs stay in order and none are dropped (deferred logging buffers printk and
# drops the oldest messages under RM_LOG_VERBOSE).
CONFIG_LOG=n
CONFIG_PRINTK=y

# --- Stack sizing (LoRa + STL on the main thread) ---
CONFIG_MAIN_STACK_SIZE=8192

# --- RadioMesh library (zephyr/Kconfig) ---
CONFIG_RADIOMESH=y
```

## inc/unity_config.h
```c
#ifndef UNITY_CONFIG_H
#define UNITY_CONFIG_H

// Unity configuration for the Zephyr on-board runner (Unity requires this file
// name). Unity writes through printk, the same console sink as the RadioMesh
// Logger, so test results and library logs come out in order.
#include <zephyr/sys/printk.h>

#define UNITY_OUTPUT_CHAR(c) printk("%c", (c))

// No setjmp/longjmp: on the ESP32-S3 they link to ROM, whose register-window
// spill syscall Zephyr does not service (it prints a register dump instead).
// A failed assertion is still recorded and reported; the test body then runs
// on instead of jumping out.
#define UNITY_EXCLUDE_SETJMP_H

#endif // UNITY_CONFIG_H
```

## src/TestRunner.cpp
```c
/**
 * On-board Unity test runner for Zephyr.
 *
 * Runs the one test/ suite built into this image (CMake -DSUITE=<name>) and
 * reports the result on the console:
 *   RM_TEST_START          the suite is about to run
 *   RM_TEST_DONE rc=<n>    n failed tests, or -1 if no test ran
 * `make test` (ports/zephyr/tools/rmon.py) waits for the DONE line.
 *
 * Suites use either entry style of the PlatformIO test environments:
 *  - Arduino style: setup() runs the tests; loop() is empty and never called.
 *  - Native style: main(), renamed to rm_test_main for the suite's sources.
 */
#include <unity.h>
#include <zephyr/kernel.h>
#include <zephyr/sys/printk.h>

void setup() __attribute__((weak));
int rm_test_main(int argc, char** argv) __attribute__((weak));

// Empty default fixtures, as PlatformIO provides: most suites define neither.
extern "C"
{
__attribute__((weak)) void setUp(void)
{
}

__attribute__((weak)) void tearDown(void)
{
}
}

int main(void)
{
    // USB-Serial-JTAG discards console output until the host opens the port
    // (~1.5 s after reset); give the monitor time to attach.
    k_msleep(3000);
    printk("RM_TEST_START\n");

    if (rm_test_main != nullptr) {
        rm_test_main(0, nullptr);
    } else if (setup != nullptr) {
        setup();
    }

    // UNITY_END() leaves the run's totals in the Unity state. A suite that ran
    // no test must never read as a pass.
    int rc = (Unity.NumberOfTests == 0) ? -1 : static_cast<int>(Unity.TestFailures);
    printk("RM_TEST_DONE rc=%d\n", rc);
    return 0;
}
```
