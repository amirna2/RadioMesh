## CMakeLists.txt
```
cmake_minimum_required(VERSION 3.20.0)

# Kit-specific: force the shared XIAO ESP32-S3 + Wio-SX1262 pin overlay (single
# source of truth in ../../common). These examples target that kit only, so we
# apply the overlay explicitly rather than relying on per-board discovery.
# Must be set before find_package(Zephyr).
set(DTC_OVERLAY_FILE "${CMAKE_CURRENT_LIST_DIR}/../../common/xiao_esp32s3_procpu.overlay")

# The RadioMesh module (zephyr/module.yml) is discovered automatically when this
# repo is on the west manifest; its zephyr/CMakeLists.txt adds the src/ include
# root when CONFIG_RADIOMESH=y (set in prj.conf).
find_package(Zephyr REQUIRED HINTS $ENV{ZEPHYR_BASE})
project(radiomesh_rx CXX)

target_include_directories(app PRIVATE "${CMAKE_CURRENT_LIST_DIR}/../../common")
target_sources(app PRIVATE src/main.cpp)
```

## prj.conf
```kconfig
# --- LoRa PHY stack (native in-tree SX126x backend; loramac-node is deprecated) ---
CONFIG_LORA=y
CONFIG_LORA_MODULE_BACKEND_NATIVE=y
CONFIG_SPI=y
CONFIG_GPIO=y

# --- C++17 with full STL (RadioMeshPacket uses std::vector/std::array/std::string) ---
CONFIG_CPP=y
CONFIG_STD_CPP17=y
CONFIG_REQUIRES_FULL_LIBC=y
CONFIG_GLIBCXX_LIBCPP=y
CONFIG_CPP_EXCEPTIONS=y

# --- Heap for std::vector/std::string allocations (tune on-target if needed) ---
CONFIG_COMMON_LIBC_MALLOC_ARENA_SIZE=16384

# --- Logging ---
CONFIG_LOG=y
CONFIG_PRINTK=y

# --- Stack sizing (LoRa + STL on the main thread) ---
CONFIG_MAIN_STACK_SIZE=8192

# --- RadioMesh neutral core (zephyr/Kconfig) ---
CONFIG_RADIOMESH=y
```

## src/main.cpp
```c
/*
 * RadioMesh Zephyr example — LoRa RX node.
 *
 * Continuously receives LoRa frames, parses each with the co-compiled
 * RadioMeshPacket buffer constructor, re-computes the payload CRC32, and logs
 * the decoded header fields. Pair with the `tx` example flashed to a second
 * XIAO ESP32-S3 + Wio-SX1262 board.
 *
 * Scope: raw point-to-point LoRa only — no routing, relay, crypto, or inclusion.
 * The PHY is configured through rm_lora_configure() (see common/lora_phy.h) so
 * this node stays wire-compatible with Arduino RadioMesh nodes (D5).
 */
#include <zephyr/device.h>
#include <zephyr/drivers/lora.h>
#include <zephyr/kernel.h>
#include <zephyr/logging/log.h>

#include <vector>

#include <common/utils/RadioMeshCrc32.h>
#include <core/protocol/inc/packet/Packet.h>

#include "lora_phy.h"

LOG_MODULE_REGISTER(rm_rx, LOG_LEVEL_INF);

#define LORA_NODE DT_ALIAS(lora0)
BUILD_ASSERT(DT_NODE_HAS_STATUS(LORA_NODE, okay),
             "lora0 alias not defined / not okay in the devicetree overlay");

#define MAX_LORA_LEN 255
#define RX_TIMEOUT K_SECONDS(10) // wake periodically to emit a liveness heartbeat

static uint32_t payload_crc(const std::vector<byte>& data)
{
    RadioMeshUtils::CRC32 crc;
    crc.update(data.data(), data.size());
    return crc.finalize();
}

int main(void)
{
    const struct device* lora = DEVICE_DT_GET(LORA_NODE);
    if (!device_is_ready(lora)) {
        LOG_ERR("LoRa device %s not ready", lora->name);
        return -ENODEV;
    }
    if (rm_lora_configure(lora, false) < 0) {
        LOG_ERR("LoRa RX config failed");
        return -EIO;
    }
    LOG_INF("RadioMesh RX node ready; listening...");

    uint8_t rx[MAX_LORA_LEN];
    uint32_t received = 0;
    while (true) {
        int16_t rssi = 0;
        int8_t snr = 0;
        int len = lora_recv(lora, rx, sizeof(rx), RX_TIMEOUT, &rssi, &snr);
        if (len <= 0) {
            LOG_INF("listening... (received=%u)", received); // heartbeat on idle timeout
            continue;
        }

        std::vector<byte> rbuf(rx, rx + len);
        RadioMeshPacket rpkt(rbuf);
        bool crc_ok = (payload_crc(rpkt.packetData) == rpkt.packetCrc);
        received++;

        LOG_INF("RX len=%d rssi=%d snr=%d | topic=0x%02x fcounter=%u dataLen=%u crc=%s", len, rssi,
                (int)snr, rpkt.topic, rpkt.fcounter, (unsigned)rpkt.packetData.size(),
                crc_ok ? "OK" : "BAD");
    }

    return 0;
}
```
