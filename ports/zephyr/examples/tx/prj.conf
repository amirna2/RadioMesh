## CMakeLists.txt
```
cmake_minimum_required(VERSION 3.20.0)

# Kit-specific: force the shared XIAO ESP32-S3 + Wio-SX1262 pin overlay (single
# source of truth in ../../common). These examples target that kit only, so we
# apply the overlay explicitly rather than relying on per-board discovery.
# Must be set before find_package(Zephyr).
set(DTC_OVERLAY_FILE "${CMAKE_CURRENT_LIST_DIR}/../../common/xiao_esp32s3_procpu.overlay")

# The RadioMesh module (zephyr/module.yml) is discovered automatically when this
# repo is on the west manifest; its zephyr/CMakeLists.txt adds the src/ include
# root when CONFIG_RADIOMESH=y (set in prj.conf).
find_package(Zephyr REQUIRED HINTS $ENV{ZEPHYR_BASE})
project(radiomesh_tx CXX)

target_include_directories(app PRIVATE "${CMAKE_CURRENT_LIST_DIR}/../../common")
target_sources(app PRIVATE src/main.cpp)
```

## prj.conf
```kconfig
# --- LoRa PHY stack (native in-tree SX126x driver) ---
CONFIG_LORA=y
CONFIG_LORA_MODULE_BACKEND_NATIVE=y
# The devicetree auto-enables the unused legacy SX126x driver symbol; keep it off.
CONFIG_LORA_SX126X=n
CONFIG_SPI=y
CONFIG_GPIO=y

# --- C++17 with full STL (RadioMeshPacket uses std::vector/std::array/std::string) ---
CONFIG_CPP=y
CONFIG_STD_CPP17=y
CONFIG_REQUIRES_FULL_LIBC=y
CONFIG_GLIBCXX_LIBCPP=y
CONFIG_CPP_EXCEPTIONS=y

# --- Heap for std::vector/std::string allocations (tune on-target if needed) ---
CONFIG_COMMON_LIBC_MALLOC_ARENA_SIZE=16384

# --- Required by the RadioMesh library (CONFIG_RADIOMESH links it whole): NVS
# storage, chip id and entropy for ports/zephyr/hal ---
CONFIG_FLASH=y
CONFIG_FLASH_MAP=y
CONFIG_NVS=y
CONFIG_HWINFO=y
CONFIG_ENTROPY_GENERATOR=y

# --- Logging ---
CONFIG_LOG=y
CONFIG_PRINTK=y

# --- Stack sizing (LoRa + STL on the main thread) ---
CONFIG_MAIN_STACK_SIZE=8192

# --- RadioMesh neutral core (zephyr/Kconfig) ---
CONFIG_RADIOMESH=y
```

## src/main.cpp
```c
/*
 * RadioMesh Zephyr example — LoRa TX node.
 *
 * Builds a RadioMeshPacket with the co-compiled, platform-neutral RadioMesh core
 * (RadioMeshPacket + CRC32) and transmits it over LoRa on a fixed cadence. Pair
 * with the `rx` example flashed to a second XIAO ESP32-S3 + Wio-SX1262 board.
 *
 * Scope: raw point-to-point LoRa only — no routing, relay, crypto, or inclusion.
 * The PHY is configured through rm_lora_configure() (see common/lora_phy.h) so
 * this node stays wire-compatible with Arduino RadioMesh nodes (D5).
 */
#include <zephyr/device.h>
#include <zephyr/drivers/lora.h>
#include <zephyr/kernel.h>
#include <zephyr/logging/log.h>

#include <vector>

#include <common/utils/RadioMeshCrc32.h>
#include <core/protocol/inc/packet/Packet.h>

#include "lora_phy.h"

LOG_MODULE_REGISTER(rm_tx, LOG_LEVEL_INF);

#define LORA_NODE DT_ALIAS(lora0)
BUILD_ASSERT(DT_NODE_HAS_STATUS(LORA_NODE, okay),
             "lora0 alias not defined / not okay in the devicetree overlay");

#define TX_PERIOD K_SECONDS(3)

static uint32_t payload_crc(const std::vector<byte>& data)
{
    RadioMeshUtils::CRC32 crc;
    crc.update(data.data(), data.size());
    return crc.finalize();
}

int main(void)
{
    const struct device* lora = DEVICE_DT_GET(LORA_NODE);
    if (!device_is_ready(lora)) {
        LOG_ERR("LoRa device %s not ready", lora->name);
        return -ENODEV;
    }
    if (rm_lora_configure(lora, true) < 0) {
        LOG_ERR("LoRa TX config failed");
        return -EIO;
    }
    LOG_INF("RadioMesh TX node ready");

    uint32_t fcounter = 0;
    while (true) {
        RadioMeshPacket pkt;
        pkt.topic = RM_APP_TOPIC;
        pkt.sourceDevId = {0x00, 0x00, 0x00, 0x01};
        pkt.destDevId = {0xFF, 0xFF, 0xFF, 0xFF};
        pkt.packetId = {(byte)(fcounter >> 24), (byte)(fcounter >> 16), (byte)(fcounter >> 8),
                        (byte)fcounter};
        pkt.fcounter = fcounter;
        pkt.packetData = {'R', 'M', (byte)(fcounter & 0xFF)};
        pkt.packetCrc = payload_crc(pkt.packetData); // "Data CRC" field = payload integrity

        std::vector<byte> buf = pkt.toByteBuffer();
        int ret = lora_send(lora, buf.data(), buf.size());
        LOG_INF("TX fcounter=%u len=%u ret=%d", fcounter, (unsigned)buf.size(), ret);

        fcounter++;
        k_sleep(TX_PERIOD);
    }

    return 0;
}
```
