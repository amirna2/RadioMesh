## zephyr/Kconfig
```kconfig
config RADIOMESH
	bool "RadioMesh mesh networking library"
	help
	  Build the RadioMesh library into the application: the portable
	  protocol core (src/common, src/core, src/framework, co-compiled with
	  the PlatformIO build), the pinned Crypto sources, and the Zephyr
	  implementations of the platform contract, radio and storage
	  (ports/zephyr/hal). The application must enable C++17, LoRa, flash,
	  NVS, hwinfo and an entropy source; see ports/zephyr/examples/standard.
```
